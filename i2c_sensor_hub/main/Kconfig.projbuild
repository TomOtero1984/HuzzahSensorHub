## i2c_sensor_hub/main/Kconfig.projbuild
```kconfig
menu "Test Options"
	menu "Test1"
		config TEST1
			int "test val"
			default 0
			help
				A test value
	endmenu
endmenu

menu "Example Configuration"

    menu "I2C Controller"
        config I2C_CONTROLLER_SCL
            int "SCL GPIO Num"
            default 6 if IDF_TARGET_ESP32C3
            default 2 if  IDF_TARGET_ESP32S3
            default 19 if IDF_TARGET_ESP32 || IDF_TARGET_ESP32S2
            help
                GPIO number for I2C CONTROLLER clock line.

        config I2C_CONTROLLER_SDA
            int "SDA GPIO Num"
            default 5 if IDF_TARGET_ESP32C3
            default 1 if  IDF_TARGET_ESP32S3
            default 18 if IDF_TARGET_ESP32 || IDF_TARGET_ESP32S2
            help
                GPIO number for I2C CONTROLLER data line.

        config I2C_CONTROLLER_PORT_NUM
            int "Port Number"
            default 1 if IDF_TARGET_ESP32 || IDF_TARGET_ESP32S2 || IDF_TARGET_ESP32S3
            default 0 if IDF_TARGET_ESP32C3
            help
                Port number for I2C CONTROLLER device.

        config I2C_CONTROLLER_FREQUENCY
            int "Controller Frequency"
            default 100000
            help
                I2C Speed of CONTROLLER device.
    endmenu

    menu "I2C Responder"
        config I2C_RESPONDER_SCL
            int "SCL GPIO Num"
            default 5
            help
                GPIO number for I2C RESPONDER clock line.

        config I2C_RESPONDER_SDA
            int "SDA GPIO Num"
            default 4
            help
                GPIO number for I2C RESPONDER data line.

        config I2C_RESPONDER_PORT_NUM
            int "Port Number"
            default 0
            help
                Port number for I2C RESPONDER device.

        config I2C_RESPONDER_ADDRESS
            hex "ESP Responder Address"
            default 0x28
            help
                Hardware Address of I2C RESPONDER Port.
    endmenu
	
	menu "MCP9808 Sensor"
		config MCP9808_ADDR
			hex "MCP9808 Sensor Address"
			default 0x18
			help
				Hardware address of MCP9808
	endmenu
		

    menu "BH1750 Sensor"
        choice BH1750_ADDR
            prompt "BH1750 I2C Address"
            default BH1750_I2C_ADDRESS_LOW
            help
                Hardware address of BH1750, which is 2 types, and determined by ADDR terminal.

            config BH1750_I2C_ADDRESS_LOW
                bool "BH1750 I2C Address(ADDR=0)"
                help
                    I2C Address of BH1750 Sensor according to your schemetic configuration.

            config BH1750_I2C_ADDRESS_High
                bool "BH1750 I2C Address(ADDR=1)"
                help
                    I2C Address of BH1750 Sensor according to your schemetic configuration.
        endchoice

        config BH1750_ADDR
            hex
            default 0x5C if BH1750_I2C_ADDRESS_High
            default 0x23 if BH1750_I2C_ADDRESS_LOW

        choice BH1750_MODE
            prompt "BH1750 Operation Mode"
            default BH1750_ONETIME_L_RESOLUTION
            help
                Operation Mode of BH1750.
                Different mode means different resolution and measurement time.
            config BH1750_CONTINU_H_RESOLUTION
                bool "Continuously H-Resolution Mode"
                help
                    Resolution is 1lx, measurement time is typically 120ms.
            config BH1750_CONTINU_H_RESOLUTION2
                bool "Continuously H-Resolution Mode2"
                help
                    Resolution is 0.5lx, measurement time is typically 120ms.
            config BH1750_CONTINU_L_RESOLUTION
                bool "Continuously L-Resolution Mode"
                help
                    Resolution is 4lx, measurement time is typically 16ms.
            config BH1750_ONETIME_H_RESOLUTION
                bool "One Time H-Resolution Mode"
                help
                    Resolution is 1lx, measurement time is typically 120ms.
                    It is automatically set to Power Down mode after measurement.
            config BH1750_ONETIME_H_RESOLUTION2
                bool "One Time H-Resolution Mode2"
                help
                    Resolution is 0.5lx, measurement time is typically 120ms.
                    It is automatically set to Power Down mode after measurement.
            config BH1750_ONETIME_L_RESOLUTION
                bool "One Time L-Resolution Mode"
                help
                    Resolution is 4lx, measurement time is typically 16ms.
                    It is automatically set to Power Down mode after measurement.
        endchoice

        config BH1750_OPMODE
            hex
            default 0x10 if BH1750_CONTINU_H_RESOLUTION
            default 0x11 if BH1750_CONTINU_H_RESOLUTION2
            default 0x13 if BH1750_CONTINU_L_RESOLUTION
            default 0x20 if BH1750_ONETIME_H_RESOLUTION
            default 0x21 if BH1750_ONETIME_H_RESOLUTION2
            default 0x23 if BH1750_ONETIME_L_RESOLUTION

    endmenu

	menu "WebSocket Config"
	    choice WEBSOCKET_URI_SOURCE
	        prompt "Websocket URI source"
	        default WEBSOCKET_URI_FROM_STRING
	        help
	            Selects the source of the URI used in the example.
	
	        config WEBSOCKET_URI_FROM_STRING
	            bool "From string"
	
	        config WEBSOCKET_URI_FROM_STDIN
	            bool "From stdin"
	    endchoice
	
	    config WEBSOCKET_URI
	        string "Websocket endpoint URI"
	        depends on WEBSOCKET_URI_FROM_STRING
	        default "ws://echo.websocket.events"
	        help
	            URL of websocket endpoint this example connects to and sends echo
	endmenu
	
endmenu
```
